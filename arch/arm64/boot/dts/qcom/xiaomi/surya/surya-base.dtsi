#include "surya-sdmmagpie-atp.dtsi"
#include "surya-sdmmagpie-sde.dtsi"
#include "surya-sdmmagpie-sde-display.dtsi"
#include "surya-sdmmagpie-camera-sensor-idp.dtsi"
#include "surya-sdmmagpie-thermal.dtsi"
#include "surya-sdmmagpie-stub-regulator.dtsi"
#include "surya-pm6150.dtsi"
#include "surya-sdmmagpie-qupv3.dtsi"
#include "batterydata-M703-ATL-6000mah.dtsi"
#include "surya-msm-audio-lpass.dtsi"
#include "surya-sdmmagpie-camera.dtsi"
#include "surya-sdmmagpie-pinctrl.dtsi"
#include "surya-pm6150l.dtsi"
#include "surya-sdmmagpie-usb.dtsi"
#include "surya-sdmmagpie-regulator.dtsi"
