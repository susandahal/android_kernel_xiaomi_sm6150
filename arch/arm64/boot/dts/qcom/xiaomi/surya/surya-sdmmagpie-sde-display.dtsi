#include "dsi-panel-nt36672c-huaxing-fhd-video.dtsi"
#include "dsi-panel-nt36672c-tianma-fhd-video.dtsi"

&soc {
	dsi_nt36672c_huaxing_fhd_video_display: qcom,dsi-display@22 {
		label = "dsi_nt36672c_huaxing_fhd_video_display";
		qcom,display-type = "primary";
		qcom,dsi-ctrl-num = <0>;
		qcom,dsi-phy-num = <0>;
		qcom,dsi-select-clocks = "mux_byte_clk0", "mux_pixel_clk0";
		qcom,dsi-panel = <&dsi_nt36672c_huaxing_fhd_video>;
	};
	dsi_nt36672c_tianma_fhd_video_display: qcom,dsi-display@23 {
		label = "dsi_nt36672c_tianma_fhd_video_display";
		qcom,display-type = "primary";
		qcom,dsi-ctrl-num = <0>;
		qcom,dsi-phy-num = <0>;
		qcom,dsi-select-clocks = "mux_byte_clk0", "mux_pixel_clk0";
		qcom,dsi-panel = <&dsi_nt36672c_tianma_fhd_video>;
	};
};

&sde_dsi {
	qcom,dsi-ctrl = <&mdss_dsi0>;
	qcom,dsi-phy = <&mdss_dsi_phy0>;
	vddio-supply = <&pm6150_l18>;
	qcom,dsi-display-list =
		<&dsi_nt36672c_huaxing_fhd_video_display
		&dsi_nt36672c_tianma_fhd_video_display
		>;
	
	/delete-property/ vdda-3p3-supply;
};